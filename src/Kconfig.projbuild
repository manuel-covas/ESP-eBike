## src/Kconfig.projbuild
```kconfig
menu "ESP-eBike Configuration"

    config BLE_NAME
        string "BLE Device Name"
        default "ESP-eBike"
        help
            The device name that will be advertised by the Bluetooth LE server.


    config AUTH_RSA_PUBLIC_KEY
        string "Authentication RSA Public Key"
        default "MIIBIjANBgkqhkiG9w0BAQEFAAOCAQ8AMIIBCgKCAQEA5BA8puOFPRgCBzO9+0rZmiT3w4NKT2alNBnrProUj9CIDMLS6AXlTyk9dheU1fbe1AywE7PZ0EO7WaI0Tf4QTRDOim02VFtK1BUeRjDHrerz3PI6u2N/75u2xwfVX27OOQiF4lpvUy8mOTgeE+YLRb9Be7qtVOjFBFslxTv7YrBab1aRrLWC2QrwFbwksWMCoMMV/8+GayRNA7ynMdyeLENJF51y2rnbKnQOaFm9W8FW4/Nao0hkY6bLb0M5SGbRhlPm+tSu/SJ/95WMDwrHOvA67Wn17dYuzUaLt27Qt0Uyh1+oZJXxfKIjHW1ABZluZqRoKmYx18qeIAJMtGDK2wIDAQAB"
        help
            The RSA public key used for authentication.

    config EBIKE_AUTH_CHALLENGE_LENGTH
        int "Crypto Challenge Length"
        default 64
        help
            The amount of random bytes to use for the crypto challenge.


    config CURRENT_SENSE_RESISTOR
        int "Current Sense Resistor Value (mOhm)"
        default 2
        help
            The value, in milliohms, of the current sense resistor.

    config OUT1_GPIO
        int "Power output 1 GPIO Number"
        default 26
        help
            The GPIO number of the pin to that activates the power output 1.

    config OUT2_GPIO
        int "Power output 2 GPIO Number"
        default 27
        help
            The GPIO number of the pin to that activates the power output 2.


    config THROTTLE_ADC1_CHANNEL
        int "ADC1 Throttle Channel Number"
        default 0
        help
            The ADC1 channel number to which the throttle analog signal is connected.

    config ADC1_MULTISAMPLING_COUNT
        int "ADC1 Multisampling Count"
        default 64
        help
            The amount of samples to take the average of for each ADC read.

    config MAGNET_GPIO
        int "Magnet GPIO Number"
        default 33
        help
            The GPIO number of the pin from which to count pulses from and calculate speed.

    config PWM_GPIO
        int "ESC PWM GPIO Number"
        default 25
        help
            The GPIO number of the output pin for the PWM ESC control signal.

    config PWM_FREQUENCY_HZ
        int "ESC PWM Frequency"
        default 50
        help
            Frequency in Hertz to use when generating the ESC PWM control signal. 


    config BUZZER_GPIO
        int "Buzzer GPIO Number"
        default 12
        help
            The GPIO number of the pin that activates the buzzer.

    config FAULT_LED_GPIO
        int "Fault LED GPIO Number"
        default 15
        help
            The GPIO number of the pin that activates the FAULT indicator led.

    config I2C_CLOCK_FREQUENCY
        int "I2C Clock Frequency"
        default 50000
        help
            The frequency to clock the I2C line at.

    config I2C_SLAVE_ADDRESS
        hex "I2C Slave Address"
        default 0x08
        help
            The slave address of the I2C connected BQ76930 chip.

    config I2C_SDA_GPIO
        int "I2C SDA GPIO Number"
        default 14
        help
            The GPIO number of the pin to use for the I2C data line.

    config I2C_SCL_GPIO
        int "I2C SCL GPIO Number"
        default 13
        help
            The GPIO number of the pin to use for the I2C clock line.


    config EBIKE_LOG_BUFFER_SIZE
        int "BLE Log Buffer Size"
        default 2048
        help
            The size, in bytes, to use for the buffer of text logs that can be read through bluetooth.


    config SYSTEM_STATS_STREAM_MIN_PERIOD_MS
        int "System Sats Minimum Update Period (Milliseconds)"
        default 200
        help
            The minimum period, in milliseconds, between updates of the BLE System Stats stream.
endmenu
```
